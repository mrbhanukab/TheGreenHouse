#include <Wire.h>
#include <Adafruit_GFX.h>
#include <Adafruit_SSD1306.h>

#define SCREEN_WIDTH 128
#define SCREEN_HEIGHT 64
#define OLED_RESET -1
Adafruit_SSD1306 display(SCREEN_WIDTH, SCREEN_HEIGHT, &Wire, OLED_RESET);

void OLEDsetup() {
  Wire.begin();
  while (!display.begin(SSD1306_SWITCHCAPVCC, 0x3C)) {
    Serial.println(F("SSD1306 allocation failed"));
    delay(2000);
  }

  display.clearDisplay();
  display.setTextSize(1);
  display.setTextColor(SSD1306_WHITE);
  display.clearDisplay();
}

// Booting
const unsigned char logo[] PROGMEM = {
  0x00, 0x00, 0x00, 0x00, 0x00, 0x00, 0x00, 0x00, 0x00, 0x00, 0x00, 0x00, 0x00, 0x00, 0x00, 0x00,
  0x00, 0x00, 0x00, 0x00, 0x00, 0x00, 0x1f, 0xff, 0x00, 0x00, 0x00, 0xff, 0xff, 0xf0, 0x00, 0x07,
  0xff, 0xff, 0xfe, 0x00, 0x1f, 0xff, 0xff, 0xfe, 0x00, 0x3f, 0xff, 0xff, 0xfe, 0x00, 0xff, 0xff,
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  0x00, 0x00, 0x00, 0x00, 0x00, 0x00, 0x00, 0x00
};

void bootingSplash(String text) {
  display.clearDisplay();
  display.drawBitmap(15, 5, logo, 40, 40, SSD1306_WHITE);
  display.setTextSize(1);
  display.setCursor(60, 12);
  display.print("The Green");
  display.setTextSize(2);
  display.setCursor(60, 22);
  display.print("House");
  display.setTextSize(1);
  display.setCursor(0, SCREEN_HEIGHT - 10);
  display.print(text);
  display.display();
}

const unsigned char validUserIcon[] PROGMEM = {
  // 'icons8-validation-30, 30x30px
  0x00, 0x00, 0x00, 0x00, 0x00, 0x00, 0x00, 0x00, 0x00, 0x00, 0x00, 0x00, 0x00, 0x00, 0x00, 0x00,
  0x00, 0x00, 0x00, 0x00, 0x00, 0x00, 0x00, 0x00, 0xff, 0xff, 0xff, 0xf0, 0xff, 0xff, 0xff, 0xf0,
  0xc0, 0x00, 0x00, 0x30, 0xc0, 0x00, 0x00, 0x30, 0xc0, 0x00, 0x00, 0x30, 0xc0, 0x00, 0x00, 0x30,
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  0x00, 0x00, 0x00, 0x00, 0x00, 0x00, 0x00, 0x00
};
const unsigned char validatingUserIcon[] PROGMEM = {
  0x00, 0x00, 0x00, 0x00, 0x00, 0x1f, 0xe0, 0x00, 0x00, 0x3f, 0x70, 0x00, 0x00, 0x78, 0x78, 0x00,
  0x00, 0xe0, 0x1c, 0x00, 0x01, 0xc0, 0x0e, 0x00, 0x01, 0xc0, 0x0e, 0x00, 0x01, 0x80, 0x02, 0x00,
  0x01, 0x80, 0x06, 0x00, 0x01, 0x80, 0x06, 0x00, 0x01, 0x80, 0x06, 0x00, 0x01, 0x80, 0x06, 0x00,
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  0x1f, 0xff, 0xff, 0xe0, 0x1f, 0xff, 0xff, 0xe0
};
const unsigned char invalidUserIcon[] PROGMEM = {
  // 'icons8-forgot-password-30, 30x30px
  0x00, 0x00, 0x00, 0x00, 0x00, 0x1f, 0xe0, 0x00, 0x00, 0x3f, 0xf0, 0x00, 0x00, 0x78, 0x78, 0x00,
  0x00, 0xe0, 0x1c, 0x00, 0x00, 0xc0, 0x0c, 0x00, 0x01, 0xc0, 0x0e, 0x00, 0x01, 0xc0, 0x0e, 0x00,
  0x01, 0x80, 0x0e, 0x00, 0x01, 0x80, 0x06, 0x00, 0x0f, 0xff, 0xff, 0xc0, 0x1f, 0xff, 0xff, 0xe0,
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  0x1f, 0xff, 0xff, 0xc0, 0x00, 0x00, 0x00, 0x00
};
const unsigned char notAuthenitcatedUser[] PROGMEM = {
  // 'icons8-private-lock-30, 30x30px
  0x00, 0x7e, 0x00, 0x00, 0x01, 0xff, 0x80, 0x00, 0x03, 0xe7, 0xc0, 0x00, 0x07, 0x81, 0xe0, 0x00,
  0x07, 0x00, 0xe0, 0x00, 0x06, 0x00, 0x60, 0x00, 0x0e, 0x00, 0x70, 0x00, 0x0e, 0x00, 0x70, 0x00,
  0x0c, 0x00, 0x30, 0x00, 0x0c, 0x00, 0x30, 0x00, 0x7f, 0xff, 0xfe, 0x00, 0xff, 0xff, 0xff, 0x00,
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  0xff, 0xff, 0xff, 0xe0, 0x00, 0x00, 0x7f, 0x80
};
//? validating screen
void validatingUserScreen() {
  display.fillRect(0, 0, SCREEN_WIDTH, 50, SSD1306_BLACK);
  display.setTextSize(1);  // Set the text size to 1 for normal text
  display.setCursor(40, 20);
  display.drawBitmap(5, 10, validatingUserIcon, 30, 30, SSD1306_WHITE);
  display.print("Validating ...");
  display.display();
}

//? valid status screen
void validStatusUserScreen(byte status) {
  display.fillRect(0, 0, SCREEN_WIDTH, 50, SSD1306_BLACK);
  display.setTextSize(1);
  display.setCursor(40, 20);
  switch (status) {
    case 1:
      display.drawBitmap(5, 10, validUserIcon, 30, 30, SSD1306_WHITE);
      display.print("Welcome!");
      break;
    case 2:
    case 3:
      display.drawBitmap(5, 10, notAuthenitcatedUser, 30, 30, SSD1306_WHITE);
      display.print("No Access!");
      break;
    default:
      display.drawBitmap(5, 10, invalidUserIcon, 30, 30, SSD1306_WHITE);
      display.print("bAd!");
      break;
  }

  display.display();
}

//? Icon for reconnecting
const unsigned char reconnectingIcon[] PROGMEM = {
  // 'icons8-wi-fi-disconnected-30, 30x30px
  0x00, 0x00, 0x00, 0x00, 0x00, 0x00, 0x00, 0x00, 0x00, 0x00, 0x00, 0x00, 0x00, 0x00, 0x00, 0x00,
  0x00, 0x7f, 0xf8, 0x00, 0x03, 0xff, 0xff, 0x00, 0x0f, 0xc0, 0x1f, 0xc0, 0x1f, 0x0f, 0xc3, 0xe0,
  0x7c, 0xff, 0xfc, 0xf8, 0xf2, 0xff, 0xff, 0x3c, 0xe7, 0xc0, 0x0f, 0x9c, 0xff, 0x1f, 0xe3, 0xfc,
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  0x00, 0x00, 0x1f, 0xf8, 0x00, 0x00, 0x0f, 0xf0
};
//? reconnecting screen
void reconnectingScreen() {
  display.clearDisplay();
  display.drawBitmap((SCREEN_WIDTH - 30) / 2, 10, reconnectingIcon, 30, 30, SSD1306_WHITE);
  display.setTextSize(1);
  display.setCursor((SCREEN_WIDTH - 84) / 2, 50);
  display.print("Connecting ...");
  display.display();
}

//? Icons for the bottom panel
const unsigned char wifiIcon[] PROGMEM = {
  // 'icons8-wifi-10(1), 10x10px
  0x00, 0x00, 0x00, 0x00, 0x39, 0x80, 0x9e, 0xc0, 0xf7, 0xc0, 0x7f, 0x80, 0x37, 0x00, 0x1e, 0x00,
  0x0c, 0x00, 0x00, 0x00
};
const unsigned char ipIcon[] PROGMEM = {
  // 'icons8-web-10, 10x10px
  0x08, 0x00, 0x3b, 0x00, 0x3f, 0x00, 0xbf, 0x80, 0xff, 0x40, 0xff, 0x80, 0x7f, 0x80, 0x7f, 0x80,
  0x3f, 0x00, 0x0c, 0x00
};

char show = 1;
unsigned long previousMillis = 0;

void bottomPanel(String ssid, String ip, bool connection) {
  unsigned long currentMillis = millis();

  if (currentMillis - previousMillis >= 3000) {
    previousMillis = currentMillis;
    switch (show) {
      case 1:
        show = 2;
        break;
      case 2:
        show = 3;
        break;
      case 3:
        show = 1;
        break;
      default:
        break;
    }
  }

  // Clear the bottom part of the screen
  display.fillRect(0, 51, SCREEN_WIDTH, 13, SSD1306_BLACK);

  // Draw the horizontal line at y=50
  display.drawLine(0, 50, SCREEN_WIDTH, 50, SSD1306_WHITE);

  // Draw SSID or IP with corresponding icon
  display.setTextSize(1);
  display.setCursor(15, 55);  // Set cursor after the icon space (icon is 10x10)

  if (show == 1) {
    display.drawBitmap(0, 53, wifiIcon, 10, 10, SSD1306_WHITE);  // Draw WiFi icon
    display.print(ssid);                                         // Display SSID
  } else if (show == 2) {
    display.drawBitmap(0, 53, ipIcon, 10, 10, SSD1306_WHITE);  // Draw IP icon
    display.print(ip);                                         // Display IP address
  } else if(show == 3) {
    display.drawBitmap(0, 53, wifiIcon, 10, 10, SSD1306_WHITE);  // Draw WiFi icon
    if (connection) display.print("WS: Connected !");
    else if(!connection) display.print("WS: Disconnected !");
  }

  // Update the OLED display with changes
  display.display();
}

//? Icons for temperature and humidity
const unsigned char temperatureIcon[] PROGMEM = {
    0x00, 0x00, 0x00, 0x00, 0x00, 0x00, 0x00, 0x00, 0x00, 0x1f, 0xc0, 0x00, 0x00, 0xff, 0xf0, 0x00,
    0x01, 0xff, 0xfc, 0x00, 0x03, 0xff, 0xfe, 0x00, 0x07, 0xe0, 0x3f, 0x00, 0x0f, 0x9f, 0x8f, 0x80,
    0x1f, 0x3f, 0xe7, 0x80, 0x1e, 0x7f, 0xf3, 0xc0, 0x1e, 0xff, 0xfb, 0xc0, 0x3d, 0xf3, 0xf9, 0xc0,
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    0x00, 0x00, 0x00, 0x00, 0x00, 0x00, 0x00, 0x00};
const unsigned char humidityIcon[] PROGMEM = {
    0x00, 0x00, 0x00, 0x00, 0x00, 0x00, 0x00, 0x00, 0x00, 0x07, 0x80, 0x00, 0x00, 0x0f, 0xc0, 0x00,
    0x00, 0x1f, 0xe0, 0x00, 0x00, 0x1f, 0xe0, 0x00, 0x00, 0x1f, 0xfc, 0x00, 0x00, 0x1f, 0xfc, 0x00,
    0x00, 0x1f, 0xfc, 0x00, 0x00, 0x1f, 0xe0, 0x00, 0x00, 0x1f, 0xfc, 0x00, 0x00, 0x1f, 0xfc, 0x00,
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    0x00, 0x00, 0x00, 0x00, 0x00, 0x00, 0x00, 0x00};
//? Show Cuurent Temprature and Humidity
bool showHumidity = true;
bool validating = false;

unsigned long previousMillis_tempAndHumidity = 0;
void showCurrentTempratureAndHumidity(int temprature, int humidity)
{
if (!validating) {
    unsigned long currentMillis = millis();

    if (currentMillis - previousMillis_tempAndHumidity >= 3500)
    {
        previousMillis_tempAndHumidity = currentMillis;
        showHumidity = !showHumidity;
    }

    display.fillRect(0, 0, SCREEN_WIDTH, 50, SSD1306_BLACK);
    display.setTextSize(2);
    display.setCursor(40, 20);
    if (showHumidity)
    {
        display.drawBitmap(5, (SCREEN_HEIGHT - 45) / 2, humidityIcon, 30, 30, SSD1306_WHITE); // Draw WiFi icon
        display.print(temprature);
        display.print("C"); // Display IP address                            // Display SSID
    }
    else
    {
        display.drawBitmap(5, (SCREEN_HEIGHT - 45) / 2, temperatureIcon, 30, 30, SSD1306_WHITE); // Draw IP icon
        display.print(humidity);
        display.print("%"); // Display IP address
    }

    display.display();
}
}
